#include <Arduino.h>
#include <Wire.h>
#include <Adafruit_GFX.h>
#include <Adafruit_SSD1306.h>
#include <WiFi.h>
#include "TimeTracker.h"
#include "Menu.h"
#include "Config.h"
#include "Pins.h"
#include "WebServerMenu.h"
#include <WebServer.h>

#define SCREEN_WIDTH 128
#define SCREEN_HEIGHT 64
#define OLED_RESET -1
#define SCREEN_ADDRESS 0x3C

const unsigned char epd_bitmap_Untitled[] PROGMEM = {
    0xff, 0xff, 0xff, 0xff, 0xff, 0xff, 0xff, 0xff, 0xff, 0xff, 0xff, 0xff, 0xff, 0xff, 0xff, 0xff,
    0xff, 0xff, 0xff, 0xff, 0xff, 0xff, 0xff, 0xff, 0xff, 0xff, 0xff, 0xff, 0xff, 0xff, 0xff, 0xff,
    0xff, 0xff, 0xff, 0xff, 0xff, 0xff, 0xff, 0xff, 0xff, 0xff, 0xff, 0xff, 0xff, 0xff, 0xff, 0xff,
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    0xff, 0xff, 0xff, 0xff, 0xff, 0xff, 0xff, 0xff, 0xff, 0xff, 0xff, 0xff, 0xff, 0xff, 0xff, 0xff};

const uint8_t BUTTON_PINS[] = {25, 26, 27, 14};
const int NUM_BUTTONS = 4;

bool buttonStates[NUM_BUTTONS] = {false};
bool lastButtonStates[NUM_BUTTONS] = {false};
unsigned long lastDebounceTime[NUM_BUTTONS] = {0};
unsigned long debounceDelay = 50;

unsigned long buttonPressStartTime[NUM_BUTTONS] = {0};
bool buttonWasPressed[NUM_BUTTONS] = {false};

Adafruit_SSD1306 display(SCREEN_WIDTH, SCREEN_HEIGHT, &Wire, OLED_RESET);
TimeTracker timeTracker;
Menu menu(&display);
Config config;
WebServer server(80);
WebServerMenu webserver(&server);

void setup()
{
  Serial.begin(115200);

  for (int i = 0; i < NUM_BUTTONS; i++)
  {
    pinMode(BUTTON_PINS[i], INPUT_PULLUP);
  }

  if (!display.begin(SSD1306_SWITCHCAPVCC, SCREEN_ADDRESS))
  {
    Serial.println(F("SSD1306 allocation failed"));
    for (;;)
      ;
  }
  display.clearDisplay();
  display.display();

  display.drawBitmap(0, 0, epd_bitmap_Untitled, 128, 32, SSD1306_WHITE);

  display.setTextColor(SSD1306_WHITE);
  display.cp437(true);

  display.setTextSize(2);
  display.setCursor(0, 34);
  display.print("by Lachlan");

  display.setTextSize(1);
  display.setCursor(0, 52);
  display.print("v1.0.0 - 2025");
  display.display();

  delay(3000);

  config.load();

  for (int i = 0; i < 4; i++)
  {
    timeTracker.setActivityName(i, config.getActivityName(i));
  }

  if (config.hasWiFiCredentials())
  {
    Serial.println("SSID: " + String(config.getSSID()) + ", Password: " + String(config.getPassword()));
    WiFi.begin(config.getSSID(), config.getPassword());
    while (WiFi.status() != WL_CONNECTED)
    {
      delay(500);
      Serial.print(".");
    }
    Serial.println("");
    Serial.println("WiFi connected.");
    Serial.println("IP address: ");
    Serial.println(WiFi.localIP());
    webserver.begin();
  }
}

void checkMenuEntry()
{
  static unsigned long menuEntryTimer = 0;

  if (buttonStates[CONFIRM_BUTTON] && buttonStates[DOWN_BUTTON])
  {
    if (menuEntryTimer == 0)
    {
      menuEntryTimer = millis();
    }
    else if (millis() - menuEntryTimer > 3000)
    {
      menu.enter();
      menuEntryTimer = 0;
    }
  }
  else
  {
    menuEntryTimer = 0;
  }
}

void handleButtons()
{
  for (int i = 0; i < NUM_BUTTONS; i++)
  {
    int reading = !digitalRead(BUTTON_PINS[i]);

    if (reading != lastButtonStates[i])
    {
      lastDebounceTime[i] = millis();
    }

    if ((millis() - lastDebounceTime[i]) > debounceDelay)
    {
      if (reading != buttonStates[i])
      {
        buttonStates[i] = reading;

        Serial.print("Button ");
        Serial.print(i);
        Serial.print(" changed to: ");
        Serial.println(buttonStates[i] ? "PRESSED" : "RELEASED");

        if (buttonStates[i])
        {
          Serial.println("Sending button press event");

          if (menu.isActive())
            menu.handleButton(i, true);
        }
        else
        {
          Serial.println("Sending button release event");
          if (menu.isActive())
          {
            menu.handleButton(-1, false);
          }
          else
          {
            timeTracker.startStopActivity(i);
          }
        }
      }
    }
    lastButtonStates[i] = reading;
  }
}

void loop()
{

  webserver.update();

  handleButtons();

  if (!menu.isActive())
  {
    checkMenuEntry();
    timeTracker.update();
    timeTracker.display(&display);
  }
  else
  {
    menu.update();
    menu.displayMenu();
  }

  delay(10);
}